/*
 * Copyright (c) 2023 Nordic Semiconductor ASA
 *
 * SPDX-License-Identifier: LicenseRef-Nordic-5-Clause
 */

/ {
	chosen {
		zephyr,code-partition = &boot_partition;
	};
};


&reg1 {
	zephyr,deferred-init;
	regulator-initial-mode = <NRF5X_REG_MODE_LDO>;
};
